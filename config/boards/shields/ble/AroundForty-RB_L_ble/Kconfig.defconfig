## config/boards/shields/ble/AroundForty-RB_L_ble/Kconfig.defconfig
```kconfig
if SHIELD_ARROUNDFORTY_RB_L_BLE

config ZMK_KEYBOARD_NAME
    default "AroundForty-RB_L_BLE"

config ZMK_SPLIT
    default y

endif
```

## config/boards/shields/ble/AroundForty-RB_L_ble/Kconfig.shield
```kconfig
config SHIELD_ARROUNDFORTY_RB_L_BLE
    def_bool $(shields_list_contains,AroundForty-RB_L_ble)
```

## config/boards/shields/ble/AroundForty-RB_R_ble/Kconfig.defconfig
```kconfig
if SHIELD_ARROUNDFORTY_RB_R_BLE

config ZMK_KEYBOARD_NAME
    default "AroundForty-RB_R_BLE"

config ZMK_SPLIT
    default y

config ZMK_SPLIT_ROLE_CENTRAL
    default y

endif
```

## config/boards/shields/ble/AroundForty-RB_R_ble/Kconfig.shield
```kconfig
config SHIELD_ARROUNDFORTY_RB_R_BLE
    def_bool $(shields_list_contains,AroundForty-RB_R_ble)
```

## config/boards/shields/dongle/AroundForty-RB_L_dongle/Kconfig.defconfig
```kconfig
if SHIELD_ARROUNDFORTY_RB_L_DONGLE

config ZMK_KEYBOARD_NAME
    default "AroundForty-RB_L_Dongle"

config ZMK_SPLIT
    default y

config ZMK_SPLIT_ROLE_CENTRAL
    default n

endif
```

## config/boards/shields/dongle/AroundForty-RB_L_dongle/Kconfig.shield
```kconfig
config SHIELD_ARROUNDFORTY_RB_L_DONGLE
    def_bool $(shields_list_contains,AroundForty-RB_L_dongle)
```

## config/boards/shields/dongle/AroundForty-RB_R_dongle/Kconfig.defconfig
```kconfig
if SHIELD_ARROUNDFORTY_RB_R_DONGLE

config ZMK_KEYBOARD_NAME
    default "AroundForty-RB_R_Dongle"

config ZMK_SPLIT
    default y

config ZMK_SPLIT_ROLE_CENTRAL
    default n

endif
```

## config/boards/shields/dongle/AroundForty-RB_R_dongle/Kconfig.shield
```kconfig
config SHIELD_ARROUNDFORTY_RB_R_DONGLE
    def_bool $(shields_list_contains,AroundForty-RB_R_dongle)
```

## config/boards/shields/dongle/AroundForty-RB_dongle/Kconfig.shield
```kconfig
config SHIELD_ARROUNDFORTY_RB_DONGLE
    def_bool $(shields_list_contains,AroundForty-RB_dongle)
```

## config/dongle/boards/shields/AroundForty-RB/Kconfig.shield
```kconfig
config SHIELD_ARROUNDFORTY_RB_R
    def_bool $(shields_list_contains,AroundForty-RB_R)

config SHIELD_ARROUNDFORTY_RB_L
    def_bool $(shields_list_contains,AroundForty-RB_L)

config SHIELD_ARROUNDFORTY_RB_R_DONGLE
    def_bool $(shields_list_contains,AroundForty-RB_R_dongle)

config SHIELD_ARROUNDFORTY_RB_L_DONGLE
    def_bool $(shields_list_contains,AroundForty-RB_L_dongle)
```

## config/west.yml
```yaml
manifest:
  remotes:
    - name: zmkfirmware
      url-base: https://github.com/zmkfirmware
    # PMW3610 driver
    - name: badjeff
      url-base: https://github.com/badjeff
    - name: caksoylar
      url-base: https://github.com/caksoylar
    - name: rschenk
      url-base: https://github.com/rschenk
  projects:
    - name: zmk
      remote: zmkfirmware
      revision: v0.3
      import: app/west.yml
    - name: zmk-pmw3610-driver
      remote: badjeff
      revision: zmk-0.3
    - name: zmk-rgbled-widget
      remote: caksoylar
      revision: v0.3-branch
    - name: zmk-component-raytac-dongle
      remote: rschenk
      revision: v0.3
  self:
    path: config
```
