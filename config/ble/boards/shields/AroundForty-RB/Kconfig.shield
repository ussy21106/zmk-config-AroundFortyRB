## config/ble/boards/shields/AroundForty-RB/Kconfig.shield
```kconfig
config SHIELD_ARROUNDFORTY_RB_R
    def_bool $(shields_list_contains,AroundForty-RB_R)

config SHIELD_ARROUNDFORTY_RB_L
    def_bool $(shields_list_contains,AroundForty-RB_L)
```
